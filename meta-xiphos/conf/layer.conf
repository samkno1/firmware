## meta-xiphos/conf/layer.conf
```bitbake
# We have a conf and classes directory, add to BBPATH
BBPATH .= ":${LAYERDIR}"

# We have recipes-* directories, add to BBFILES
BBFILES += "${LAYERDIR}/recipes-*/*/*.bb \
            ${LAYERDIR}/recipes-*/*/*.bbappend"

BBFILE_COLLECTIONS += "meta-xiphos"
BBFILE_PATTERN_meta-xiphos = "^${LAYERDIR}/"
BBFILE_PRIORITY_meta-xiphos = "10"

LAYERDEPENDS_meta-xiphos = "core"
LAYERSERIES_COMPAT_meta-xiphos = "scarthgap"
```
